## boards/shields/key30x2/Kconfig.defconfig
```kconfig
if SHIELD_KEY30X2_L

config ZMK_KEYBOARD_NAME
    default "key30x2"

config ZMK_SPLIT_ROLE_CENTRAL
    default y

endif

if SHIELD_KEY30X2_R || SHIELD_KEY30X2_L

config ZMK_SPLIT
    default y

endif
```

## boards/shields/key30x2/Kconfig.shield
```kconfig
config SHIELD_KEY30X2_LEFT
    def_bool $(shields_list_contains,key30x2_left)

config SHIELD_KEY30X2_RIGHT
    def_bool $(shields_list_contains,key30x2_right)
```

## boards/shields/key30x2/board.yml
```yaml
board:
  name: key30x2            # ビルド時に指定するボード名
  vendor: zmk                      # ベンダー名（任意）
  socs:
    - name: nrf52840_qiaa          # 使用しているSoC名
```
